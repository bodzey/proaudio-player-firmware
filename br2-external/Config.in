## br2-external/Config.in
```kconfig
menu "ProAudio Player"

source "$BR2_EXTERNAL_PROAUDIO_PATH/package/proaudio-shairport-sync/Config.in"
source "$BR2_EXTERNAL_PROAUDIO_PATH/package/proaudio-spotifyd/Config.in"
source "$BR2_EXTERNAL_PROAUDIO_PATH/package/proaudio-networkd/Config.in"
source "$BR2_EXTERNAL_PROAUDIO_PATH/package/proaudio-player/Config.in"
source "$BR2_EXTERNAL_PROAUDIO_PATH/package/proaudio-player-native/Config.in"
source "$BR2_EXTERNAL_PROAUDIO_PATH/package/proaudio-webui/Config.in"

endmenu
```

## br2-external/configs/proaudio_qemu_aarch64_defconfig
```kconfig
BR2_aarch64=y
BR2_DOWNLOAD_FORCE_CHECK_HASHES=y
BR2_INSTALL_LIBSTDCPP=y
BR2_PACKAGE_HOST_LINUX_HEADERS_CUSTOM_6_18=y
BR2_GLOBAL_PATCH_DIR="board/qemu/patches"
BR2_TARGET_GENERIC_HOSTNAME="proaudio-player-qemu"
BR2_TARGET_GENERIC_ISSUE="ProAudio Player - QEMU AArch64 DEV"
BR2_TARGET_ENABLE_ROOT_LOGIN=y
BR2_TARGET_GENERIC_ROOT_PASSWD=""
BR2_INIT_SYSTEMD=y
BR2_SYSTEM_DHCP="eth0"
BR2_SYSTEM_DEFAULT_PATH="/bin:/sbin:/usr/bin:/usr/sbin"
BR2_TARGET_TZ_ZONELIST="europe"
BR2_TARGET_LOCALTIME="Europe/Kyiv"
BR2_ROOTFS_OVERLAY="$(BR2_EXTERNAL_PROAUDIO_PATH)/board/common/rootfs-overlay $(BR2_EXTERNAL_PROAUDIO_PATH)/board/qemu-aarch64/rootfs-overlay"
BR2_ROOTFS_POST_BUILD_SCRIPT="$(BR2_EXTERNAL_PROAUDIO_PATH)/board/common/post-build-native.sh"
BR2_ROOTFS_POST_IMAGE_SCRIPT="board/qemu/post-image.sh"
BR2_ROOTFS_POST_SCRIPT_ARGS="$(BR2_DEFCONFIG)"
BR2_LINUX_KERNEL=y
BR2_LINUX_KERNEL_CUSTOM_VERSION=y
BR2_LINUX_KERNEL_CUSTOM_VERSION_VALUE="6.18.7"
BR2_LINUX_KERNEL_USE_CUSTOM_CONFIG=y
BR2_LINUX_KERNEL_CUSTOM_CONFIG_FILE="board/qemu/aarch64-virt/linux.config"
BR2_LINUX_KERNEL_NEEDS_HOST_OPENSSL=y
# BR2_PACKAGE_FFMPEG_FFMPEG is not set
# BR2_PACKAGE_MPD_ALSA is not set
# BR2_PACKAGE_MPD_MAD is not set
# BR2_PACKAGE_AVAHI_AUTOIPD is not set
BR2_TARGET_ROOTFS_EXT2=y
BR2_TARGET_ROOTFS_EXT2_4=y
BR2_TARGET_ROOTFS_EXT2_SIZE="768M"
# BR2_TARGET_ROOTFS_TAR is not set
BR2_PACKAGE_HOST_QEMU=y
BR2_PACKAGE_HOST_QEMU_SYSTEM_MODE=y
# BR2_PACKAGE_PROAUDIO_PLAYER is not set
BR2_PACKAGE_PROAUDIO_PLAYER_NATIVE=y
BR2_PACKAGE_PROAUDIO_WEBUI=y
# BR2_PACKAGE_PROAUDIO_NETWORKD is not set
```

## br2-external/configs/proaudio_rpi4_64_defconfig
```kconfig
BR2_aarch64=y
BR2_DOWNLOAD_FORCE_CHECK_HASHES=y
BR2_cortex_a72=y
BR2_ARM_FPU_VFPV4=y
BR2_TOOLCHAIN_EXTERNAL=y
BR2_TOOLCHAIN_EXTERNAL_BOOTLIN=y
BR2_TOOLCHAIN_EXTERNAL_BOOTLIN_AARCH64_GLIBC_BLEEDING_EDGE=y
BR2_INSTALL_LIBSTDCPP=y
BR2_GLOBAL_PATCH_DIR="board/raspberrypi/patches"
BR2_TARGET_GENERIC_HOSTNAME="proaudio-player"
BR2_TARGET_GENERIC_ISSUE="ProAudio network streaming Player - DEV"
BR2_TARGET_ENABLE_ROOT_LOGIN=y
BR2_TARGET_GENERIC_ROOT_PASSWD=""
BR2_INIT_SYSTEMD=y
BR2_SYSTEM_DHCP="end0"
BR2_SYSTEM_DEFAULT_PATH="/bin:/sbin:/usr/bin:/usr/sbin"
BR2_TARGET_TZ_ZONELIST="europe"
BR2_TARGET_LOCALTIME="Europe/Kyiv"
BR2_ROOTFS_OVERLAY="$(BR2_EXTERNAL_PROAUDIO_PATH)/board/common/rootfs-overlay $(BR2_EXTERNAL_PROAUDIO_PATH)/board/raspberrypi4-64/rootfs-overlay"
BR2_ROOTFS_POST_BUILD_SCRIPT="board/raspberrypi4-64/post-build.sh $(BR2_EXTERNAL_PROAUDIO_PATH)/board/raspberrypi4-64/post-build.sh $(BR2_EXTERNAL_PROAUDIO_PATH)/board/raspberrypi4-64/post-build-native.sh"
BR2_ROOTFS_POST_IMAGE_SCRIPT="$(BR2_EXTERNAL_PROAUDIO_PATH)/board/raspberrypi4-64/post-image.sh"
BR2_LINUX_KERNEL=y
BR2_LINUX_KERNEL_CUSTOM_TARBALL=y
BR2_LINUX_KERNEL_CUSTOM_TARBALL_LOCATION="$(call github,raspberrypi,linux,21b410140c47ffab5668399f6f143c7d7b935c8b)/linux-21b410140c47ffab5668399f6f143c7d7b935c8b.tar.gz"
BR2_LINUX_KERNEL_DEFCONFIG="bcm2711"
BR2_LINUX_KERNEL_CONFIG_FRAGMENT_FILES="$(BR2_EXTERNAL_PROAUDIO_PATH)/board/raspberrypi4-64/linux-headless-usb.fragment"
BR2_LINUX_KERNEL_DTS_SUPPORT=y
BR2_LINUX_KERNEL_INTREE_DTS_NAME="broadcom/bcm2711-rpi-4-b"
BR2_LINUX_KERNEL_NEEDS_HOST_OPENSSL=y
BR2_PACKAGE_BUSYBOX_SHOW_OTHERS=y
BR2_PACKAGE_XZ=y
BR2_PACKAGE_RPI_FIRMWARE=y
BR2_PACKAGE_RPI_FIRMWARE_VARIANT_PI4=y
BR2_PACKAGE_RPI_FIRMWARE_CONFIG_FILE="$(BR2_EXTERNAL_PROAUDIO_PATH)/board/raspberrypi4-64/config.txt"
BR2_PACKAGE_RPI_FIRMWARE_CMDLINE_FILE="$(BR2_EXTERNAL_PROAUDIO_PATH)/board/raspberrypi4-64/cmdline.txt"
BR2_PACKAGE_KMOD=y
BR2_PACKAGE_KMOD_TOOLS=y
BR2_PACKAGE_OPENSSH=y
BR2_PACKAGE_OPENSSH_SERVER=y
BR2_PACKAGE_OPENSSH_KEY_UTILS=y
BR2_PACKAGE_E2FSPROGS=y
BR2_PACKAGE_E2FSPROGS_RESIZE2FS=y
BR2_PACKAGE_UTIL_LINUX=y
BR2_PACKAGE_UTIL_LINUX_BINARIES=y
# BR2_PACKAGE_FFMPEG_FFMPEG is not set
# BR2_PACKAGE_MPD_ALSA is not set
# BR2_PACKAGE_MPD_MAD is not set
# BR2_PACKAGE_AVAHI_AUTOIPD is not set
# BR2_PACKAGE_DNSMASQ_TFTP is not set
BR2_TARGET_ROOTFS_EXT2=y
BR2_TARGET_ROOTFS_EXT2_4=y
BR2_TARGET_ROOTFS_EXT2_LABEL="PROAUDIO_SYSTEM"
BR2_TARGET_ROOTFS_EXT2_SIZE="768M"
# BR2_TARGET_ROOTFS_TAR is not set
BR2_PACKAGE_HOST_DOSFSTOOLS=y
BR2_PACKAGE_HOST_GENIMAGE=y
BR2_PACKAGE_HOST_KMOD_XZ=y
BR2_PACKAGE_HOST_MTOOLS=y
BR2_PACKAGE_PROAUDIO_PLAYER_NATIVE=y
BR2_PACKAGE_PROAUDIO_WEBUI=y
BR2_PACKAGE_PROAUDIO_NETWORKD=y
```

## br2-external/package/proaudio-networkd/Config.in
```kconfig
config BR2_PACKAGE_PROAUDIO_NETWORKD
	bool "proaudio-networkd Wi-Fi provisioning"
	depends on BR2_INIT_SYSTEMD
	depends on BR2_PACKAGE_HAS_UDEV
	depends on BR2_PACKAGE_HOST_RUSTC_TARGET_ARCH_SUPPORTS
	depends on BR2_USE_MMU
	depends on !BR2_STATIC_LIBS
	depends on BR2_USE_WCHAR
	depends on BR2_TOOLCHAIN_HAS_THREADS
	depends on !BR2_PACKAGE_LINUX_FIRMWARE_BRCM_BCM43XXX
	select BR2_PACKAGE_NETWORK_MANAGER
	select BR2_PACKAGE_NETWORK_MANAGER_CLI
	select BR2_PACKAGE_WPA_SUPPLICANT
	select BR2_PACKAGE_WPA_SUPPLICANT_NL80211
	select BR2_PACKAGE_WPA_SUPPLICANT_AP_SUPPORT
	select BR2_PACKAGE_WPA_SUPPLICANT_WPA3
	select BR2_PACKAGE_WPA_SUPPLICANT_DBUS
	select BR2_PACKAGE_DNSMASQ
	select BR2_PACKAGE_DNSMASQ_DHCP
	select BR2_PACKAGE_LIBGPIOD
	select BR2_PACKAGE_LIBGPIOD_TOOLS
	select BR2_PACKAGE_BRCMFMAC_SDIO_FIRMWARE_RPI
	select BR2_PACKAGE_BRCMFMAC_SDIO_FIRMWARE_RPI_WIFI
	select BR2_PACKAGE_IW
	select BR2_PACKAGE_WIRELESS_REGDB
	help
	  Rust headless Wi-Fi provisioning service for ProAudio Player.
	  It owns first-boot setup AP/captive portal behavior, Ethernet
	  preference, Wi-Fi recovery and the physical setup button.
	  Python is not required by the target runtime.

comment "proaudio-networkd requirements are not satisfied"
	depends on !BR2_INIT_SYSTEMD || !BR2_PACKAGE_HAS_UDEV || 		!BR2_PACKAGE_HOST_RUSTC_TARGET_ARCH_SUPPORTS || !BR2_USE_MMU || 		BR2_STATIC_LIBS || !BR2_USE_WCHAR || !BR2_TOOLCHAIN_HAS_THREADS || 		BR2_PACKAGE_LINUX_FIRMWARE_BRCM_BCM43XXX
```

## br2-external/package/proaudio-player-native/Config.in
```kconfig
config BR2_PACKAGE_PROAUDIO_PLAYER_NATIVE
	bool "proaudio-player-native"
	depends on BR2_INIT_SYSTEMD
	depends on BR2_PACKAGE_HOST_RUSTC_TARGET_ARCH_SUPPORTS
	depends on BR2_USE_WCHAR
	depends on BR2_TOOLCHAIN_HAS_THREADS
	depends on BR2_TOOLCHAIN_HAS_ATOMIC
	depends on !BR2_STATIC_LIBS
	select BR2_PACKAGE_BASH
	select BR2_PACKAGE_CA_CERTIFICATES
	select BR2_PACKAGE_SYSTEMD_TIMESYNCD
	select BR2_PACKAGE_ALSA_LIB
	select BR2_PACKAGE_ALSA_UTILS
	select BR2_PACKAGE_ALSA_UTILS_AMIXER
	select BR2_PACKAGE_ALSA_UTILS_APLAY
	select BR2_PACKAGE_PIPEWIRE
	# pw-record/pw-cat are built by Buildroot's PipeWire package when libsndfile
	# is enabled. Native meters capture the logical buses through pw-record.
	select BR2_PACKAGE_LIBSNDFILE
	select BR2_PACKAGE_LUA
	select BR2_PACKAGE_LUA_5_4
	select BR2_PACKAGE_WIREPLUMBER
	select BR2_PACKAGE_MPV
	select BR2_PACKAGE_MPD
	select BR2_PACKAGE_MPD_ALSA
	select BR2_PACKAGE_MPD_CURL
	select BR2_PACKAGE_MPD_FFMPEG
	select BR2_PACKAGE_MPD_MPC
	help
	  Native Rust control plane for ProAudio Player. PipeWire is
	  the realtime audio engine. ALSA is retained for physical
	  hardware and for media engines using PipeWire's ALSA PCM.

if BR2_PACKAGE_PROAUDIO_PLAYER_NATIVE

config BR2_PACKAGE_PROAUDIO_PLAYER_NATIVE_AIRPLAY
	bool "AirPlay receiver"
	default y
	select BR2_PACKAGE_PROAUDIO_SHAIRPORT_SYNC
	help
	  Enable Shairport Sync with its native PipeWire backend and
	  MPRIS support.

config BR2_PACKAGE_PROAUDIO_PLAYER_NATIVE_DLNA
	bool "DLNA / UPnP renderer"
	default y
	select BR2_PACKAGE_GMRENDER_RESURRECT
	select BR2_PACKAGE_IPROUTE2
	select BR2_PACKAGE_PIPEWIRE_GSTREAMER
	select BR2_PACKAGE_GST1_PLUGINS_GOOD
	select BR2_PACKAGE_GST1_PLUGINS_GOOD_PLUGIN_AUDIOPARSERS
	select BR2_PACKAGE_GST1_PLUGINS_GOOD_PLUGIN_SOUPHTTPSRC
	select BR2_PACKAGE_GST1_LIBAV
	help
	  Enable the GStreamer-based DLNA/UPnP renderer with native
	  PipeWire output.

config BR2_PACKAGE_PROAUDIO_PLAYER_NATIVE_SPOTIFY
	bool "Spotify Connect"
	default y
	depends on BR2_PACKAGE_HOST_RUSTC_TARGET_ARCH_SUPPORTS
	select BR2_PACKAGE_PROAUDIO_SPOTIFYD
	help
	  Enable spotifyd with ALSA output routed into PipeWire and
	  system-bus MPRIS integration.

comment "Spotify Connect needs Rust support for the target architecture"
	depends on !BR2_PACKAGE_HOST_RUSTC_TARGET_ARCH_SUPPORTS

endif

comment "proaudio-player-native needs systemd, Rust target support, wchar, threads, atomics and dynamic libraries"
	depends on !BR2_INIT_SYSTEMD || !BR2_PACKAGE_HOST_RUSTC_TARGET_ARCH_SUPPORTS || \
		!BR2_USE_WCHAR || !BR2_TOOLCHAIN_HAS_THREADS || !BR2_TOOLCHAIN_HAS_ATOMIC || \
		BR2_STATIC_LIBS
```

## br2-external/package/proaudio-player/Config.in
```kconfig
config BR2_PACKAGE_PROAUDIO_PLAYER
	bool "proaudio-player"
	depends on BR2_INIT_SYSTEMD
	depends on BR2_INSTALL_LIBSTDCPP
	depends on BR2_USE_WCHAR
	depends on BR2_TOOLCHAIN_HAS_THREADS_NPTL
	depends on BR2_TOOLCHAIN_HAS_ATOMIC
	depends on BR2_TOOLCHAIN_HAS_SYNC_4
	depends on BR2_TOOLCHAIN_GCC_AT_LEAST_12
	depends on BR2_HOST_GCC_AT_LEAST_10
	depends on BR2_TOOLCHAIN_HEADERS_AT_LEAST_5_6
	depends on BR2_PACKAGE_FFMPEG_ARCH_SUPPORTS
	depends on BR2_PACKAGE_PULSEAUDIO_HAS_ATOMIC
	depends on !BR2_STATIC_LIBS
	select BR2_PACKAGE_BASH
	select BR2_PACKAGE_CA_CERTIFICATES
	select BR2_PACKAGE_SYSTEMD_TIMESYNCD
	select BR2_PACKAGE_PYTHON3
	select BR2_PACKAGE_PYTHON3_SSL
	select BR2_PACKAGE_PYTHON_AIOHTTP
	select BR2_PACKAGE_PYTHON_PYYAML
	select BR2_PACKAGE_PYTHON_SERIAL
	select BR2_PACKAGE_ALSA_LIB
	select BR2_PACKAGE_PIPEWIRE
	select BR2_PACKAGE_PULSEAUDIO
	select BR2_PACKAGE_LUA
	select BR2_PACKAGE_LUA_5_4
	select BR2_PACKAGE_WIREPLUMBER
	select BR2_PACKAGE_MPV
	select BR2_PACKAGE_MPD
	select BR2_PACKAGE_MPD_PULSEAUDIO
	select BR2_PACKAGE_MPD_CURL
	select BR2_PACKAGE_MPD_FFMPEG
	select BR2_PACKAGE_MPD_MPC
	help
	  ProAudio Player application, alert controller and web UI.
	  Includes PipeWire audio buses and a local MPD source.

if BR2_PACKAGE_PROAUDIO_PLAYER

config BR2_PACKAGE_PROAUDIO_PLAYER_AIRPLAY
	bool "AirPlay receiver"
	default y
	select BR2_PACKAGE_PROAUDIO_SHAIRPORT_SYNC
	help
	  Enable Shairport Sync with the PulseAudio backend and Avahi.

config BR2_PACKAGE_PROAUDIO_PLAYER_DLNA
	bool "DLNA / UPnP renderer"
	default y
	select BR2_PACKAGE_GMRENDER_RESURRECT
	select BR2_PACKAGE_GST1_PLUGINS_GOOD
	select BR2_PACKAGE_GST1_PLUGINS_GOOD_PLUGIN_PULSE
	select BR2_PACKAGE_GST1_LIBAV
	help
	  Enable the GStreamer-based DLNA/UPnP renderer.

config BR2_PACKAGE_PROAUDIO_PLAYER_SPOTIFY
	bool "Spotify Connect"
	default y
	depends on BR2_PACKAGE_HOST_RUSTC_TARGET_ARCH_SUPPORTS
	select BR2_PACKAGE_PROAUDIO_SPOTIFYD
	help
	  Enable spotifyd with only the PulseAudio playback backend.

comment "Spotify Connect needs Rust support for the target architecture"
	depends on !BR2_PACKAGE_HOST_RUSTC_TARGET_ARCH_SUPPORTS

endif

comment "proaudio-player needs systemd, C++, NPTL, wchar, atomics, sync4, gcc >= 12, headers >= 5.6 and dynamic libraries"
	depends on !BR2_INIT_SYSTEMD || !BR2_INSTALL_LIBSTDCPP || !BR2_USE_WCHAR || \
		!BR2_TOOLCHAIN_HAS_THREADS_NPTL || !BR2_TOOLCHAIN_HAS_ATOMIC || \
		!BR2_TOOLCHAIN_HAS_SYNC_4 || !BR2_TOOLCHAIN_GCC_AT_LEAST_12 || \
		!BR2_TOOLCHAIN_HEADERS_AT_LEAST_5_6 || BR2_STATIC_LIBS
```

## br2-external/package/proaudio-shairport-sync/Config.in
```kconfig
config BR2_PACKAGE_PROAUDIO_SHAIRPORT_SYNC
	bool
	depends on BR2_TOOLCHAIN_HAS_THREADS_NPTL
	depends on BR2_INSTALL_LIBSTDCPP
	depends on BR2_USE_WCHAR
	depends on BR2_PACKAGE_PULSEAUDIO_HAS_ATOMIC
	depends on !BR2_STATIC_LIBS
	select BR2_PACKAGE_AVAHI
	select BR2_PACKAGE_AVAHI_DAEMON
	select BR2_PACKAGE_DBUS
	select BR2_PACKAGE_LIBCONFIG
	select BR2_PACKAGE_OPENSSL
	select BR2_PACKAGE_POPT
	select BR2_PACKAGE_PULSEAUDIO
```

## br2-external/package/proaudio-spotifyd/Config.in
```kconfig
config BR2_PACKAGE_PROAUDIO_SPOTIFYD
	bool
	depends on BR2_PACKAGE_HOST_RUSTC_TARGET_ARCH_SUPPORTS
	depends on BR2_USE_WCHAR
	depends on BR2_TOOLCHAIN_HAS_THREADS
	depends on !BR2_STATIC_LIBS
	select BR2_PACKAGE_ALSA_LIB
	select BR2_PACKAGE_DBUS
	select BR2_PACKAGE_OPENSSL
```

## br2-external/package/proaudio-webui/Config.in
```kconfig
config BR2_PACKAGE_PROAUDIO_WEBUI
	bool "proaudio-webui"
	depends on BR2_PACKAGE_PROAUDIO_PLAYER_NATIVE
	select BR2_PACKAGE_HOST_NODEJS
	help
	  Optional browser frontend for ProAudio Player. The frontend
	  is built independently from the native Rust control plane
	  and communicates with it through the versioned HTTP API.

	  Node.js is used only on the build host. The target image
	  receives only the generated static assets under
	  /usr/share/proaudio-player/webui. Disabling this package
	  must not affect playback, alerts, source arbitration or API
	  operation.
```
